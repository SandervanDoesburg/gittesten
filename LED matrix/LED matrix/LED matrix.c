/*
 * Project		: Microcontrollers eindopdracht
 * Bestand		: LED_matrix.c
 * Auteur		: Matthijs 
 * Datum		: 13-1-2014 10:45:18
 * Omschrijving	: LED Matrix
 *
 */ 

#define F_CPU 2000000UL

#include <avr/io.h>
#include <util/delay.h>
#include <string.h>
#include "spi.h"


const uint8_t lookupcol[][8] = {							
	{0x80, 0x40, 0x20, 0x10, 0x08, 0x04, 0x02, 0x01},
};



const uint8_t lookuprow[][8] = {							
	{0x11, 0x11, 0x11, 0x1F, 0x11, 0x11, 0x11, 0x0E},		// A
	{0x1E, 0x11, 0x11, 0x11, 0x1E, 0x11, 0x11, 0x1E},		// B
	{0x0E, 0x11, 0x10, 0x10, 0x10, 0x10, 0x11, 0x0E},		// C
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	{0x00, 0x00, 0x00, 0x00, 0x00, 0x00, 0x00, 0x00},		// Spatie	
};



int main(void)
{
	spi_init();
	
	PORTC.DIRSET = PIN0_bm;														
	
	int stringlength, temp, index, rowcol = 0;
	
	unsigned int buffer[] = {0,0,0,0,0,0,0,0};
		
	char message[] = " MATTHIJS VISSER ";
		
	stringlength = strlen(message);
	
	while(1) 
	{
		for (int a=0; a<stringlength; a++)
		{
			for (int scroll = 0; scroll < 8; scroll++)
			{
				for (int shift = 0; shift < 8; shift++)
					{
						index = message[a];
						
						if (index == 32)
						{
							index = index - 6;			// spatie
						}
						else
						{
							index = index - 65;			// A t/m Z
						}
						
						temp = lookuprow[index][shift];
						
						buffer[shift] = (buffer[shift] << 1)|(temp >> ((7)-scroll));

						
							for(int i=0; i<8; i++)
							{
								
								spi_transfer((lookupcol[rowcol][i]));

								spi_transfer((buffer[i]));

			
								PORTC_OUT = PIN0_bm;
								_delay_ms(1.5);
								
							}
					}
		}
	}
}
}